## zephyr/Kconfig.shell
```kconfig
# Copyright (c) 2023 Fabian Blatz <fabianblatz@gmail.com>
# SPDX-License-Identifier: Apache-2.0

config LV_Z_SHELL
	bool "LVGL Shell"
	depends on SHELL
	help
	  Enable LVGL shell for testing.

if LV_Z_SHELL && LV_USE_MONKEY

config LV_Z_MAX_MONKEY_COUNT
	int "Maximum number of monkeys"
	default 4
	help
	  Number of monkey instances that can exist in parallel

endif
```
